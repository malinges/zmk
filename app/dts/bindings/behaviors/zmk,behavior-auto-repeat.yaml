## app/dts/bindings/behaviors/zmk,behavior-auto-repeat.yaml
```yaml
# Copyright (c) 2021 The ZMK Contributors
# SPDX-License-Identifier: MIT

description: Auto-repeat behavior

compatible: "zmk,behavior-auto-repeat"

properties:
  label:
    type: string
    required: true
  "#binding-cells":
    type: int
    required: true
  bindings:
    type: phandles
    required: true
  initial-delay-ms:
    type: int
    default: 500
  repeat-delay-ms:
    type: int
    default: 250
  press-duration-ms:
    type: int
    default: 10

binding-cells:
  - param1
  - param2
```
